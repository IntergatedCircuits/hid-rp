## mcux/Kconfig
```kconfig
menuconfig HID_RP
    bool "HID Report Protocol C++ library"
    help
        This option enables the HID Report Protocol library target, and generates the HID usage page headers.

if HID_RP

# TODO: configure HID_RP_ASSERT behavior

endif # HID_RP
```

## zephyr/Kconfig
```kconfig
menuconfig HID_RP
    bool "HID Report Protocol C++ library"
    depends on CPP
    # imply STD_CPP20
    help
        This option enables the HID Report Protocol library target, and generates the HID usage page headers.

if HID_RP

# TODO: configure HID_RP_ASSERT behavior

endif # HID_RP
```

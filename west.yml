## west.yml
```yaml
manifest:
  self:
    path: hid-rp
  defaults:
    remote: IntergatedCircuits

  remotes:
    - name: IntergatedCircuits
      url-base: https://github.com/IntergatedCircuits

  projects:
    - name: bitfilled
      revision: 6b9c2272e3957e64e5e2c6ffb5360121a654d4c0
```
